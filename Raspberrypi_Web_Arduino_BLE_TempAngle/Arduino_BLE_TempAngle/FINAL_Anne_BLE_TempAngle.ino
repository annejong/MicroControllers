#include <ArduinoBLE.h>
#include <Arduino_HTS221.h>
#include <Arduino_LPS22HB.h>
#include <Arduino_LSM9DS1.h>
 
// Declare the variables for reading barometric pressure, temperature, and humidity, respectively.
float p;
float t;
float h;
float x, y, z;
int degreesX = 0;
int degreesY = 0;

// Declare Bluetooth service name, and characteristics. All are standard GATT services.
BLEService environmentalSensingService("181A");
BLEUnsignedIntCharacteristic pressureCharacteristic("2A6D", BLERead); // 32-bit unsigned in Pascals, 1 decimal place.
BLEShortCharacteristic temperatureCharacteristic("2A6E", BLERead); // 16-bit signed, 2 decimal places.
BLEUnsignedIntCharacteristic humidityCharacteristic("2A6F", BLERead); // 16-bit unsigned, 2 decimal places.
BLEShortCharacteristic CharacteristicX("2201", BLERead); 
BLEShortCharacteristic CharacteristicY("2202", BLERead); 
BLEShortCharacteristic CharacteristicZ("2203", BLERead); 


// Error pulse of death. Loops forever. Only used if there are problems.
void error_pulse() {
  while (1) {
    for (int i=0; i<3; i++) {
      digitalWrite(LED_BUILTIN, HIGH);
      delay(166);
      digitalWrite(LED_BUILTIN, LOW);
      delay(167);
    }
    delay(1001);
  }  
}

void setup() {
  // Illuminate LED for 5sec to indicate startup. 
  pinMode(LED_BUILTIN, OUTPUT);
  digitalWrite(LED_BUILTIN, HIGH);
  delay(5000);

  // Initialize serial for debug output.
  Serial.begin(9600);

  // Initialize atmospheric sensors.
  Serial.println("Initializing humidity and temperature sensor.");
  if (!HTS.begin()) {
    Serial.println("Failed.");
    error_pulse();
  }
  Serial.println("Initializing barometric pressure sensor.");
  if (!BARO.begin()) {
    Serial.println("Failed.");
    error_pulse();
  }

    Serial.println("Initializing sensor");
  if (!IMU.begin()) { Serial.println("Failed to initialize IMU!");  while (1);  }


  // Initialize Bluetooth communication.
  Serial.println("Initializing Bluetooth communication.");
  if (!BLE.begin()) {
    Serial.println("Failed.");
    error_pulse();
  }

  // Set up Bluetooth Environmental Sensing service.
  Serial.println("Setting up service with characteristics for pressure, temperature, and humidity.");
  BLE.setLocalName("Nano33BLE");
  BLE.setAdvertisedService(environmentalSensingService);

  // Add characteristics for barometric pressure, temperature, and humidity.
  environmentalSensingService.addCharacteristic(pressureCharacteristic);
  environmentalSensingService.addCharacteristic(temperatureCharacteristic);
  environmentalSensingService.addCharacteristic(humidityCharacteristic);
  environmentalSensingService.addCharacteristic(CharacteristicX);
  environmentalSensingService.addCharacteristic(CharacteristicY);
  environmentalSensingService.addCharacteristic(CharacteristicZ);

  // Make the service available.
  BLE.addService(environmentalSensingService);
  BLE.setConnectable(true);
  Serial.println("Advertising services.");
  BLE.advertise();

  // Turn off LED to indicate startup is complete.
  digitalWrite(LED_BUILTIN, LOW);
}

void loop() {

  // Wait for a connection from a central.
  BLEDevice central = BLE.central();

  // When a connection is made, activate LED and write address to serial for debug.
  if (central) {
    digitalWrite(LED_BUILTIN, HIGH);
    Serial.print("Incoming connection from: ");
    Serial.println(central.address());

    while (central.connected()) {
      // Get readings from sensors and update the charcteristic values.
      p = BARO.readPressure(KILOPASCAL);
      t = HTS.readTemperature(CELSIUS) - 4; // Subtract 4 deg C to compensate for heat generated by Nano 33 board.
      h = HTS.readHumidity();

      // Write values to serial port for debug.
      Serial.print("Pressure: ");
      Serial.print(p);
      Serial.println("kPa");
      Serial.print("Temperature: ");
      Serial.print(t);
      Serial.println("°C");
      Serial.print("Humidity: ");
      Serial.print(h);
      Serial.println("%");

      if (IMU.accelerationAvailable()) { IMU.readAcceleration(x, y, z);  }
      degreesX = map(100*abs(x), 0, 100, 0, 90);  // map values 0-1 to 0-90
      degreesY = map(100*abs(y), 0, 100, 0, 90);
      Serial.print(degreesX);
      Serial.println("  degrees");
      Serial.print(degreesY);
      Serial.println("  degrees");

  
      // Update Bluetooth characteristics with new values.
      pressureCharacteristic.writeValue((uint32_t) round(p * 10000)); // Convert kPa to Pa and shift for one decimal place.
      temperatureCharacteristic.writeValue((int16_t) round(t * 100)); // Shift for two decimal places.
      humidityCharacteristic.writeValue((uint16_t) round(h * 100)); // Shift for two decimal places.

      CharacteristicX.writeValue((int16_t) round(degreesX*10)); 
      CharacteristicY.writeValue((int16_t) round(degreesY*10)); 

      // Delay between updates. (Don't make too long of connections start to timeout.)
      delay(3000);
    }

    // Turn off LED when connection is dropped. 
    digitalWrite(LED_BUILTIN, LOW);
    Serial.println("Connection terminated.");
  }
}
